## conf/layer.conf
```bitbake
# Board specific layer configuration for meta-mender
# Copyright 2022 estape

# We have a conf and classes directory, add to BBPATH
BBPATH .= ":${LAYERDIR}"

# We have recipes-* directories, add to BBFILES
BBFILES += "${LAYERDIR}/recipes-*/*/*.bb \
	${LAYERDIR}/recipes-*/*/*.bbappend"

BBFILE_COLLECTIONS += "mender-tibbo"
BBFILE_PATTERN_mender-tibbo = "^${LAYERDIR}/"
# rpi
#BBFILE_PRIORITY_mender-tibbo = "10"

# beaglebone
BBFILE_PRIORITY_mender-tibbo = "6"

LAYERDEPENDS_mender-tibbo = "mender"

LAYERSERIES_COMPAT_mender-tibbo = "dunfell"

_MENDER_BOOTLOADER_DEFAULT ?= "mender-uboot"
```
